## sensor-node/sdkconfig.defaults
```kconfig
# Target Chip Configuration for ESP32-S3
CONFIG_IDF_TARGET="esp32s3"

# CPU Frequency
CONFIG_ESP_DEFAULT_CPU_FREQ_MHZ_240=y

# FreeRTOS
CONFIG_FREERTOS_HZ=1000

# PSRAM Support (8MB Octal)
CONFIG_SPIRAM=y
CONFIG_SPIRAM_MODE_OCT=y

# Flash Size (8MB)
CONFIG_ESPTOOLPY_FLASHSIZE_8MB=y

# Component Logging
CONFIG_LOG_DEFAULT_LEVEL_INFO=y
```
